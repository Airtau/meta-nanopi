## conf/machine/m1.conf
```bitbake
#@TYPE: Machine
#@NAME: NanoPi-M1
#@SOC: Allwinner H3
#@DESCRIPTION: Machine configuration for FriendlyARM NanoPi-M1

DEFAULTTUNE = "cortexa7hf-neon-vfpv4"
require conf/machine/include/tune-cortexa7.inc

SOC_FAMILY = "sun8i"
include conf/machine/include/soc-family.inc

IMAGE_CLASSES += "sdcard_image-nanopi"
IMAGE_FSTYPES += "tar.gz ext4 nanopi-sdimg"

PREFERRED_PROVIDER_virtual/kernel = "linux-megous"
PREFERRED_VERSION_linux = "4.10"
KERNEL_IMAGETYPE = "uImage"
KERNEL_DEVICETREE = " \
	sun8i-h3-nanopi-m1.dtb \
	\
	overlay/sun8i-h3-analog-codec.dtbo \
	overlay/sun8i-h3-cir.dtbo \
	overlay/sun8i-h3-i2c0.dtbo \
	overlay/sun8i-h3-pwm.dtbo \
	overlay/sun8i-h3-spdif-out.dtbo \
	overlay/sun8i-h3-spi-add-cs1.dtbo \
	overlay/sun8i-h3-spi-spidev.dtbo \
	overlay/sun8i-h3-uart1.dtbo \
	overlay/sun8i-h3-uart2.dtbo \
	overlay/sun8i-h3-usbhost0.dtbo \
	overlay/sun8i-h3-usbhost2.dtbo \
	overlay/sun8i-h3-usbhost3.dtbo \
	\
	overlay/sun8i-h3-fixup.scr \
	"

PREFERRED_VERSION_u-boot = "v2017.03"
UBOOT_MACHINE = "nanopi_m1_defconfig"
UBOOT_ENTRYPOINT = "0x40008000"
UBOOT_LOADADDRESS = "0x400080OB00"

SERIAL_CONSOLE = "115200 ttyS0"

RDEPENDS_kernel-base = ""
MACHINE_EXTRA_RRECOMMENDS += " kernel-modules"

MACHINE_FEATURES = "apm ext2 vfat serial screen usbhost"

# todo: move to conf/disto
DISTRO_FEATURES_append = " opengl x11 wayland irda"
```

## conf/machine/neo.conf
```bitbake
#@TYPE: Machine
#@NAME: NanoPi-Neo
#@SOC: Allwinner H3
#@DESCRIPTION: Machine configuration for FriendlyARM NanoPi-Neo

DEFAULTTUNE = "cortexa7hf-neon-vfpv4"
require conf/machine/include/tune-cortexa7.inc

SOC_FAMILY = "sun8i"
include conf/machine/include/soc-family.inc

IMAGE_CLASSES += "sdcard_image-nanopi"
IMAGE_FSTYPES += "tar.gz ext4 nanopi-sdimg"

PREFERRED_PROVIDER_virtual/kernel = "linux-megous"
PREFERRED_VERSION_linux = "4.10"
KERNEL_IMAGETYPE = "uImage"
KERNEL_DEVICETREE = " \
	sun8i-h3-nanopi-neo.dtb \
	\
	overlay/sun8i-h3-analog-codec.dtbo \
	overlay/sun8i-h3-cir.dtbo \
	overlay/sun8i-h3-i2c0.dtbo \
	overlay/sun8i-h3-pwm.dtbo \
	overlay/sun8i-h3-spdif-out.dtbo \
	overlay/sun8i-h3-spi-add-cs1.dtbo \
	overlay/sun8i-h3-spi-spidev.dtbo \
	overlay/sun8i-h3-uart1.dtbo \
	overlay/sun8i-h3-uart2.dtbo \
	overlay/sun8i-h3-usbhost0.dtbo \
	overlay/sun8i-h3-usbhost2.dtbo \
	overlay/sun8i-h3-usbhost3.dtbo \
	\
	overlay/sun8i-h3-fixup.scr \
	"

PREFERRED_VERSION_u-boot = "v2017.03%"
UBOOT_MACHINE = "nanopi_neo_defconfig"
UBOOT_ENTRYPOINT = "0x40008000"
UBOOT_LOADADDRESS = "0x400080OB00"

SERIAL_CONSOLE = "115200 ttyS0"

MACHINE_EXTRA_RRECOMMENDS = "kernel-modules"
MACHINE_FEATURES = "apm ext2 vfat serial screen usbhost"
```
